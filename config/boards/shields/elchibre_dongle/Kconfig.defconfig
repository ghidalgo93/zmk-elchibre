## config/boards/shields/elchibre_dongle/Kconfig.defconfig
```kconfig
if SHIELD_ELCHIBRE_DONGLE

config ZMK_KEYBOARD_NAME
    default "El Chibre"

config ZMK_SPLIT_ROLE_CENTRAL
    default y

endif
```

## config/boards/shields/elchibre_dongle/Kconfig.shield
```kconfig
config SHIELD_ELCHIBRE_DONGLE
    def_bool $(shields_list_contains,elchibre_dongle)
```
